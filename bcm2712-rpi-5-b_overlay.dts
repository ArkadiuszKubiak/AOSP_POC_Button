// SPDX-License-Identifier: GPL-2.0
/dts-v1/;

#include "../bcm2712-rpi-5-b.dts"

/ {
	gpio_irq_counter {
		compatible = "custom,gpio-irq-counter";
		gpios = <&gpio 23 GPIO_ACTIVE_LOW>;
		gpio-pull-up;
	};
};
